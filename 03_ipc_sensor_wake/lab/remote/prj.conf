## CMakeLists.txt
```
cmake_minimum_required(VERSION 3.20.0)

find_package(Zephyr REQUIRED HINTS $ENV{ZEPHYR_BASE})
project(lab03_ipc_sensor_wake_m4)

target_sources(app PRIVATE src/main.c)
target_include_directories(app PRIVATE include)
```

## prj.conf
```kconfig
# Lab 03 (M4) - console output, I2C1 for the onboard accelerometer
# (mc3479), the sensor subsystem, and the mbox link to M55.

CONFIG_PRINTK=y
CONFIG_CONSOLE=y
CONFIG_UART_CONSOLE=y
CONFIG_SERIAL=y

CONFIG_I2C=y
CONFIG_SENSOR=y
CONFIG_MC3419=y

CONFIG_MBOX=y
```

## boards/sr100_rdk_sr100_m4.overlay
```dts
/*
 * Lab 03: M4 masters the shared I2C1 bus in this lab to read the onboard
 * accelerometer (mc3479, at I2C address 0x4c). i2c1 itself is already
 * "okay" by base devicetree default (left unmodified here, matching this
 * project's established convention -- see Lab 01's M55 overlay for the
 * same pattern in the opposite direction), but mc3479 itself defaults to
 * "disabled" in the base devicetree and must be enabled explicitly.
 *
 * mc3479's int-gpios property (wired through gpio_exp0) is only used if
 * the driver's own interrupt-trigger mode is enabled; this lab only ever
 * calls sensor_sample_fetch() by polling, so that property is simply
 * unused here -- it does not need gpio_exp0 to be enabled.
 *
 * ipc0's shared-memory-size must match exactly between the M55 and M4
 * overlays in this lab.
 */

&mc3479 {
	status = "okay";
};

&ipc0 {
	shared-memory-size = <0x400>;
};
```

## src/main.c
```c
/*
 * Lab 03 - M4 side: continuously monitor the onboard accelerometer
 * (mc3479 on I2C1) and notify M55 over mbox ONLY when the motion state
 * changes (still <-> active), not on every sample.
 *
 * This is the third kind of "wake" in this curriculum, after Lab 01's
 * WFI (shallow, resumes exactly where it left off) and Lab 02's watchdog
 * reset (deep, restarts main() from scratch): here M55 stays fully alive
 * the whole time and is simply woken by another core's message, with no
 * restart of any kind.
 *
 * Hardware-confirmed (2026-09-21): shaking the board produces a clean
 * STILL/ACTIVE alternation on the M55 side with no missed or duplicate
 * events, using ACCEL_THRESHOLD_MILLI_G = 2000 as-is (no retuning
 * needed for this board/mounting).
 *
 * Design notes:
 *  - Baseline calibration: at boot, average ACCEL_CALIB_SAMPLES samples
 *    to capture the gravity/mounting offset as a one-time snapshot, then
 *    compare every later sample's deviation from that baseline (not from
 *    zero) against the threshold. Moving the board during calibration
 *    folds that motion into the baseline -- this is a fixed snapshot, not
 *    an adaptive filter.
 *  - Send-on-change, not send-on-every-sample: an mbox notify is sent
 *    only when the motion state actually flips (STILL -> ACTIVE or back),
 *    never on every poll. A naive "send whenever over threshold" design
 *    would instead spam a notify on every single sample while the board
 *    sits just above the threshold.
 *  - The sensor stays in a low-power standby state after init until an
 *    output data rate (ODR) and full-scale range are both explicitly set
 *    with sensor_attr_set() -- skip either one and every sample silently
 *    reads back as all-zero, with no error returned.
 *  - mbox_send_dt() is called here directly from this thread's own
 *    context (main()'s own loop, never from an ISR/callback). This lab
 *    has no rx side on M4 at all (M55 never replies), so there is no
 *    mbox callback here and nothing that could call mbox_send_dt() from
 *    ISR context by mistake.
 */

#include <zephyr/kernel.h>
#include <zephyr/sys/printk.h>
#include <zephyr/device.h>
#include <zephyr/drivers/sensor.h>
#include <zephyr/drivers/mbox.h>

#include "ipc_common.h"

#define POLL_PERIOD_MS 100
#define ACCEL_CALIB_SAMPLES 10          /* ~1s of samples at POLL_PERIOD_MS */
#define ACCEL_THRESHOLD_MILLI_G 2000     /* deviation from baseline to trip */

static const struct device *const accel = DEVICE_DT_GET(DT_NODELABEL(mc3479));

static struct mbox_dt_spec tx_channel = MBOX_DT_SPEC_GET(DT_PATH(mbox_consumer), tx);

static int32_t base_x, base_y, base_z;

static int32_t abs32(int32_t v)
{
	return v < 0 ? -v : v;
}

static int read_accel_milli_g(int32_t *x, int32_t *y, int32_t *z)
{
	struct sensor_value sx, sy, sz;
	int ret = sensor_sample_fetch(accel);

	if (ret != 0) {
		return ret;
	}

	sensor_channel_get(accel, SENSOR_CHAN_ACCEL_X, &sx);
	sensor_channel_get(accel, SENSOR_CHAN_ACCEL_Y, &sy);
	sensor_channel_get(accel, SENSOR_CHAN_ACCEL_Z, &sz);

	/* struct sensor_value -> milli-g: val1 is whole g, val2 is micro-g */
	*x = sx.val1 * 1000 + sx.val2 / 1000;
	*y = sy.val1 * 1000 + sy.val2 / 1000;
	*z = sz.val1 * 1000 + sz.val2 / 1000;
	return 0;
}

static void calibrate_baseline(void)
{
	int64_t sum_x = 0, sum_y = 0, sum_z = 0;
	int got = 0;

	for (int i = 0; i < ACCEL_CALIB_SAMPLES; i++) {
		int32_t x, y, z;

		if (read_accel_milli_g(&x, &y, &z) == 0) {
			sum_x += x;
			sum_y += y;
			sum_z += z;
			got++;
		}
		k_msleep(POLL_PERIOD_MS);
	}

	if (got == 0) {
		base_x = base_y = base_z = 0;
		printk("[M4] calibration got no valid samples -- baseline left at 0,0,0\n");
		return;
	}

	base_x = (int32_t)(sum_x / got);
	base_y = (int32_t)(sum_y / got);
	base_z = (int32_t)(sum_z / got);
	printk("[M4] baseline calibrated over %d samples: x=%d y=%d z=%d milli-g\n",
	       got, base_x, base_y, base_z);
}

int main(void)
{
	printk("\n=== Lab 03 (M4): accelerometer monitor, notify M55 on state change ===\n");

	if (!device_is_ready(accel)) {
		printk("[M4] accelerometer device not ready (check DT_NODELABEL(mc3479) status)\n");
		return 0;
	}

	/* ODR (wake the sensor out of standby) -- required, see design notes. */
	struct sensor_value odr = { .val1 = 50, .val2 = 0 };

	sensor_attr_set(accel, SENSOR_CHAN_ACCEL_XYZ, SENSOR_ATTR_SAMPLING_FREQUENCY, &odr);

	/* Full-scale range (fills in the driver's internal sensitivity value)
	 * -- required, see design notes. Index 0 selects the driver's
	 * default/narrowest range. */
	struct sensor_value range = { .val1 = 0, .val2 = 0 };

	sensor_attr_set(accel, SENSOR_CHAN_ACCEL_XYZ, SENSOR_ATTR_FULL_SCALE, &range);

	if (!device_is_ready(tx_channel.dev)) {
		printk("[M4] mbox tx channel not ready\n");
		return 0;
	}

	calibrate_baseline();

	enum motion_state state = MOTION_STATE_STILL;
	uint32_t seq = 0;

	printk("[M4] monitoring started (threshold=%d milli-g)\n", ACCEL_THRESHOLD_MILLI_G);

	while (1) {
		int32_t x, y, z;

		if (read_accel_milli_g(&x, &y, &z) == 0) {
			int32_t dev = abs32(x - base_x) + abs32(y - base_y) + abs32(z - base_z);
			enum motion_state new_state =
				(dev > ACCEL_THRESHOLD_MILLI_G) ? MOTION_STATE_ACTIVE
								 : MOTION_STATE_STILL;

			if (new_state != state) {
				state = new_state;
				seq++;

				struct ipc_motion_event evt = {
					.seq = seq,
					.state = (uint8_t)state,
					.deviation_mg = dev,
				};
				struct mbox_msg msg = { .data = &evt, .size = sizeof(evt) };

				printk("[M4] state changed -> %s (deviation=%d milli-g), notifying M55 (seq=%u)\n",
				       state == MOTION_STATE_ACTIVE ? "ACTIVE" : "STILL", dev, seq);
				mbox_send_dt(&tx_channel, &msg);
			}
		}

		k_msleep(POLL_PERIOD_MS);
	}

	return 0;
}
```

## include/ipc_common.h
```c
/*
 * Lab 03 - shared message layout between M55 (listener) and M4
 * (accelerometer monitor). Only one message type ever flows in this lab
 * (M4 -> M55: "the motion state just changed"), so unlike a
 * general-purpose protocol there is no type/command tag here.
 */
#ifndef IPC_COMMON_H_
#define IPC_COMMON_H_

#include <stdint.h>

enum motion_state {
	MOTION_STATE_STILL = 0,
	MOTION_STATE_ACTIVE = 1,
};

struct ipc_motion_event {
	uint32_t seq;          /* event sequence number, starts at 1 */
	uint8_t state;         /* enum motion_state: the state just entered */
	int32_t deviation_mg;  /* |dx|+|dy|+|dz| from the baseline, in
				 * milli-g, at the moment the state changed */
};

#endif /* IPC_COMMON_H_ */
```

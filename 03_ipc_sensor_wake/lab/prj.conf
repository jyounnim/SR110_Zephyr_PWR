## CMakeLists.txt
```
cmake_minimum_required(VERSION 3.20.0)

find_package(Zephyr REQUIRED HINTS $ENV{ZEPHYR_BASE})
project(lab03_ipc_sensor_wake_m55)

target_sources(app PRIVATE src/main.c)
target_include_directories(app PRIVATE include)
```

## prj.conf
```kconfig
# Lab 03 (M55) - console output plus the mbox link to M4.
#
# M55 only listens for M4's motion-state notifications in this lab -- it
# never sends anything back, so only the rx side of mbox is used.

CONFIG_PRINTK=y
CONFIG_CONSOLE=y
CONFIG_UART_CONSOLE=y
CONFIG_SERIAL=y

CONFIG_MBOX=y
```

## boards/sr100_rdk_sr100_m55.overlay
```dts
/*
 * Lab 03: M4 needs sole ownership of the shared I2C1 bus in this lab, to
 * read its onboard accelerometer (mc3479) -- see
 * remote/boards/sr100_rdk_sr100_m4.overlay. M55 has no local sensor or
 * button use here, so it disables i2c1 and everything hanging off it
 * (the opposite direction from Lab 01, where M55 was the master).
 *
 * A disabled parent bus alone is not enough: child nodes that don't
 * explicitly set their own status stay at their base "okay" default and
 * still try to reference the (now-disabled) bus, which fails to compile
 * -- see this project's Lab 01 troubleshooting doc and the separate
 * M4<->M55 IPC curriculum for the same issue. Both children are disabled
 * explicitly here for that reason.
 *
 * ipc0's shared-memory-size must match exactly between the M55 and M4
 * overlays in this lab.
 */

&gpio_exp0 {
	status = "disabled";
};

&ov02c10 {
	status = "disabled";
};

&i2c1 {
	status = "disabled";
};

&ipc0 {
	shared-memory-size = <0x400>;
};
```

## src/main.c
```c
/*
 * Lab 03 - M55 side: wait for M4's accelerometer motion-state
 * notifications over mbox and log them. No response is ever sent back to
 * M4 in this lab (a deliberately one-way "wake" channel), so M55 only
 * opens the rx side and never touches mbox_send_dt() at all.
 *
 * Design notes (hardware-confirmed 2026-09-21):
 *  - main()'s loop blocks forever on k_msgq_get(..., K_FOREVER). Every
 *    event -- ACTIVE or STILL alike -- is handled and then the loop goes
 *    straight back to that same blocking call, which is exactly where
 *    Zephyr's idle thread is free to put the CPU into WFI again. This is
 *    the same underlying mechanism as Lab 01's IDLE mode; what differs is
 *    the wake source -- not a fixed sleep timer expiring, but another
 *    core's message arriving live -- and that M55 never restarts (unlike
 *    Lab 02's watchdog reset, which restarts main() from scratch).
 *  - mbox's rx callback runs in ISR context (an M4<->M55 IPC pattern
 *    established, and hardware-confirmed, in this project's separate IPC
 *    curriculum on this same board): it must never block, so it only
 *    copies the message into a k_msgq and returns immediately. All real
 *    handling (logging here) happens in main()'s own thread instead.
 *  - Confirmed on hardware: shaking the board produces a clean
 *    STILL/ACTIVE alternation with no missed or duplicate events, and no
 *    devicetree/Kconfig mismatches turned up at build time (mbox_consumer,
 *    ipc0 and mc3479 all matched this repo's SDK as designed).
 */

#include <zephyr/kernel.h>
#include <zephyr/sys/printk.h>
#include <zephyr/drivers/mbox.h>
#include <string.h>

#include "ipc_common.h"

static struct mbox_dt_spec rx_channel = MBOX_DT_SPEC_GET(DT_PATH(mbox_consumer), rx);

K_MSGQ_DEFINE(evt_msgq, sizeof(struct ipc_motion_event), 8, 4);

static void mbox_rx_callback(const struct device *dev, mbox_channel_id_t channel_id,
			      void *user_data, struct mbox_msg *data)
{
	ARG_UNUSED(dev);
	ARG_UNUSED(channel_id);
	ARG_UNUSED(user_data);

	struct ipc_motion_event evt;

	if (data->size < sizeof(evt)) {
		return;
	}

	memcpy(&evt, data->data, sizeof(evt));

	/* ISR context: never block here (no k_msleep, no mbox_send_dt) --
	 * just hand off to the queue and return. */
	k_msgq_put(&evt_msgq, &evt, K_NO_WAIT);
}

int main(void)
{
	printk("\n=== Lab 03 (M55): waiting for M4 motion-state notifications ===\n");

	if (!device_is_ready(rx_channel.dev)) {
		printk("[M55] mbox rx channel not ready\n");
		return 0;
	}

	mbox_register_callback_dt(&rx_channel, mbox_rx_callback, NULL);
	mbox_set_enabled_dt(&rx_channel, 1);

	printk("[M55] idle, waiting for events (CPU goes to WFI between them)...\n");

	while (1) {
		struct ipc_motion_event evt;

		k_msgq_get(&evt_msgq, &evt, K_FOREVER);
		printk("[M55] event seq=%u: M4 is now %s (deviation=%d milli-g)\n",
		       evt.seq, evt.state == MOTION_STATE_ACTIVE ? "ACTIVE" : "STILL",
		       evt.deviation_mg);
	}

	return 0;
}
```

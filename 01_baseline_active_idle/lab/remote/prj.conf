## CMakeLists.txt
```
cmake_minimum_required(VERSION 3.20.0)

find_package(Zephyr REQUIRED HINTS $ENV{ZEPHYR_BASE})
project(lab01_baseline_active_idle_m4)

target_sources(app PRIVATE src/main.c)
```

## prj.conf
```kconfig
# Lab 01 (M4) - Always-On heartbeat only. No sensors/IPC in this lab yet.

CONFIG_PRINTK=y
CONFIG_CONSOLE=y
CONFIG_UART_CONSOLE=y
CONFIG_SERIAL=y
```

## boards/sr100_rdk_sr100_m4.overlay
```dts
/*
 * Lab 01 v2: M4's workload in this lab (a fixed heartbeat) does not use
 * I2C1 at all, and M55 now needs to be the sole master of the shared
 * I2C1 bus to read the onboard SW8 button through gpio_exp0 (see the M55
 * overlay in this same lab). Disable both here on M4 -- this is the
 * opposite of this lab's previous version, which enabled them on M4 by
 * default (base devicetree) while M55 disabled them.
 *
 * Same "one physical I2C1 bus, only one master" rule established in this
 * project's M4<->M55 IPC curriculum.
 */

&i2c1 {
	status = "disabled";
};

&gpio_exp0 {
	status = "disabled";
};
```

## src/main.c
```c
/*
 * Lab 01 - M4 side: fixed Always-On workload.
 *
 * M4 is the Always-On core in this SoC and its power state never changes
 * in this curriculum -- only M55's does. This lab is about isolating
 * M55's own Active/Idle current delta, so M4 must contribute the *same*
 * baseline current regardless of which mode M55 is in. A simple, fixed
 * 1-second heartbeat satisfies that without requiring any external
 * sensor hardware to be wired up yet.
 *
 * This heartbeat is a placeholder for M4's real Always-On monitoring
 * role (e.g. periodic sensor polling). A real sensor-based workload is
 * introduced once IPC between M4 and M55 is added in a later lab.
 */

#include <zephyr/kernel.h>
#include <zephyr/sys/printk.h>

#define HEARTBEAT_PERIOD_MS 1000

int main(void)
{
	uint32_t tick = 0;

	printk("\n=== Lab 01 (M4): Always-On heartbeat ===\n");

	while (1) {
		printk("[M4 heartbeat] tick=%u, uptime=%u ms\n",
		       tick++, k_uptime_get_32());
		k_msleep(HEARTBEAT_PERIOD_MS);
	}

	return 0;
}
```
